;************** AULA 01 - PROGRAMA PARA PISCAR LED *****************
LIST   P=PIC16F628A
RADIX DEC	
#INCLUDE <P16F628A.INC>
	__CONFIG _INTRC_OSC_NOCLKOUT & _WDT_OFF & _PWRTE_ON & _BODEN_OFF & _LVP_OFF & _CP_OFF & _MCLRE_OFF & _DATA_CP_OFF 
	;ou __CONFIG H'3F10'

	CBLOCK	0x20	;ENDEREÇO INICIAL DA MEMÓRIA DE
					;USUÁRIO
	CONTADOR1
	CONTADOR2
	ENDC			;FIM DO BLOCO DE MEMÓRIA		
	
	ORG	0x00		;ENDEREÇO INICIAL DE PROCESSAMENTO
	GOTO	INICIO
		
INICIO
	CLRF	PORTA		;LIMPA O PORTA
	CLRF	PORTB		;LIMPA O PORTB
	BSF STATUS, RP0
	CLRF TRISB
	BCF STATUS, RP0

REPETE
	BSF PORTB, 1
	CALL ATRASO
	CALL ATRASO
	CALL ATRASO
	CALL ATRASO
	CALL ATRASO
	CALL ATRASO
	CALL ATRASO
	CALL FIM
	CALL FIM
	CALL FIM
	CALL FIM
	CALL FIM
	CALL FIM
	CALL FIM
	CALL FIM
	NOP
	NOP	
	NOP
	NOP
	NOP
	NOP
	BCF PORTB, 1
	CALL ATRASO
	CALL ATRASO
	CALL ATRASO
	CALL ATRASO
	CALL ATRASO
	CALL ATRASO
	CALL ATRASO
	CALL FIM
	CALL FIM
	CALL FIM
	CALL FIM
	CALL FIM
	CALL FIM
	CALL FIM
	CALL FIM
	NOP
	NOP	
	NOP
	NOP
	NOP
	NOP
	GOTO REPETE
FIM
	MOVLW	243
	MOVWF	CONTADOR1
	GOTO FIN
	GOTO FINAL
FIN
	DECFSZ CONTADOR1
	GOTO FIN
	RETURN
FINAL
	DECFSZ CONTADOR1
	GOTO FINAL
	RETURN
ATRASO				
	MOVLW	124
	MOVWF	CONTADOR1
	MOVWF	CONTADOR2
	GOTO ATRASO1
ATRASO1			
	DECFSZ  CONTADOR1
	GOTO	ATRASO3
	RETURN
ATRASO2
	DECFSZ	CONTADOR2
	GOTO ATRASO2
	GOTO ATRASO1
	RETURN
ATRASO3
	DECFSZ	CONTADOR2
	GOTO ATRASO3
	GOTO ATRASO2
	GOTO ATRASO1
	RETURN

	

END